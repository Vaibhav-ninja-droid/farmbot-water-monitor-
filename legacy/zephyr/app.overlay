#include <zephyr/dt-bindings/gpio/gpio.h>
/ {
    aliases {
        sonar - pw = &sonar_pw;
    };
sonar_pw:
    sonar - pw {
        compatible = "farmbot,sonar-pw";
        status = "okay";
        /* Existing project pin. Verify wiring before flashing. */
        gpios = <&gpio0 3 GPIO_ACTIVE_HIGH>;
    };
};
